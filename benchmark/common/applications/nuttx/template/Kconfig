## benchmark/common/applications/nuttx/template/Kconfig
```kconfig
config SYSTEM_SENSOR_SAMPLE
	bool "Cross-OS benchmark manual acquisition client"
	default n
	depends on SENSORS
```

## benchmark/common/evaluation/nuttx/sim/app/Kconfig
```kconfig
config SYSTEM_BENCH_EVALUATOR
	bool "Independent driver behavior evaluator"
	default n
	select ARCH_HAVE_UDELAY
	select ARCH_HAVE_DYNAMIC_UDELAY
```

## benchmark/common/evaluation/nuttx/sim/defconfig
```kconfig
CONFIG_ARCH="sim"
CONFIG_ARCH_SIM=y
CONFIG_ARCH_CHIP="sim"
CONFIG_ARCH_BOARD="sim"
CONFIG_ARCH_BOARD_SIM=y
CONFIG_SIM_WALLTIME_SIGNAL=y
CONFIG_BOARDCTL=y
CONFIG_BOARDCTL_POWEROFF=y
CONFIG_BOARD_CRASHDUMP_CUSTOM=y
CONFIG_BOOT_RUNFROMEXTSRAM=y
CONFIG_IDLETHREAD_STACKSIZE=16384
CONFIG_INIT_ENTRYPOINT="bench_main"
CONFIG_INIT_STACKSIZE=32768
CONFIG_DEFAULT_TASK_STACKSIZE=16384
CONFIG_PTHREAD_STACK_DEFAULT=16384
CONFIG_USEC_PER_TICK=1000
CONFIG_DEBUG_FEATURES=y
CONFIG_DEBUG_ASSERTIONS=y
CONFIG_DEBUG_ASSERTIONS_EXPRESSION=y
CONFIG_DEBUG_SYMBOLS=y
CONFIG_LIBC_FLOATINGPOINT=y
CONFIG_LIBM=y
CONFIG_SENSORS=y
CONFIG_SENSORS_USE_FLOAT=y
CONFIG_I2C=y
CONFIG_SPI=y
CONFIG_SPI_EXCHANGE=y
CONFIG_SPI_CMDDATA=y
CONFIG_SCHED_WAITPID=y
CONFIG_SCHED_HAVE_PARENT=y
CONFIG_SCHED_CHILD_STATUS=y
CONFIG_SCHED_WORKQUEUE=y
CONFIG_SCHED_HPWORK=y
CONFIG_SCHED_LPWORK=y
CONFIG_SYSTEM_BENCH_EVALUATOR=y
```
