/* SPDX-License-Identifier: Apache-2.0 */
&i2c0 {
	status = "okay";
	source_sensor: bh1750@23 {
		compatible = "rohm,bh1750";
		reg = <0x23>;
		status = "okay";
		resolution = <1>;
		mtreg = <69>;
	};
};
