/* SPDX-License-Identifier: Apache-2.0 */
&i2c0 {
	status = "okay";
	source_sensor: mpu6050@68 {
		compatible = "invensense,mpu6050";
		reg = <0x68>;
		status = "okay";
		accel-fs = <2>;
		gyro-fs = <250>;
		smplrt-div = <9>;
	};
};
