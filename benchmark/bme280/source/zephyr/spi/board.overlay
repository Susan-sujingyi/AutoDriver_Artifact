/* SPDX-License-Identifier: Apache-2.0 */
&spi0 {
	status = "okay";
	source_sensor: bme280@0 {
		compatible = "bosch,bme280";
		reg = <0>;
        spi-max-frequency = <1000000>;
        spi-cpol; spi-cpha;
		status = "okay";
	};
};
